## trunk/linux-4.4.x/drivers/net/ethernet/raeth/Kconfig
```kconfig
config RAETH
	tristate "Mediatek Ethernet GMAC"
	---help---
	  This driver supports Mediatek gigabit ethernet family of
	  adapters.

	  Note that the answer to this question doesn't directly affect the
	  kernel: saying N will just cause the configurator to skip all
	  the questions about Mediatek Ethernet devices. If you say Y,
	  you will be asked for your specific card in the following questions.

if RAETH

config  GE1_SGMII_FORCE_2500
	bool "SGMII_FORCE_2500 (GigaSW)"
	depends on RAETH
	---help---
	  If you want to use sgmii force 2500.
	  Please enable GE1_SGMII_FORCE_2500.
          Switch must support SGMII interface.
	  This config will impact switch app makefile.

config ETH_SKB_ALLOC_SELECT
	bool "SKB Allocation API Select"

choice
	prompt "SKB Allocation API Selection"
	depends on ETH_SKB_ALLOC_SELECT
	default ETH_PAGE_ALLOC_SKB

config  ETH_SLAB_ALLOC_SKB
	bool "SLAB skb allocation"

config  ETH_PAGE_ALLOC_SKB
	bool "Page skb allocation"

endchoice

config  RAETH_ESW_CONTROL
	bool "Embedded (or MT7530) Switch Control Module (VLAN/Isolation/Status)"
	default y

config RAETH_ESW_DEFER_PHY_POWER
	bool "延后交换机 PHY 上电至 WAN/LAN 隔离完成"
	depends on SOC_MT7621 && RAETH_ESW_CONTROL
	default n
	help
	  保持内核初始化期间的 PHY 关闭状态，由 rc 的 init_bridge
	  完成交换机隔离后调用 phy_ports_power 开启端口。
	  目前仅 RM2100 配置启用，其他机型保持原有行为。

config  RAETH_ESW_PORT_WAN
	int "ESW WAN Port ID (0..4)"
	depends on RAETH_ESW_CONTROL
	default 4

config  RAETH_ESW_PORT_LAN1
	int "ESW LAN1 Port ID (0..4)"
	depends on RAETH_ESW_CONTROL
	default 0

config  RAETH_ESW_PORT_LAN2
	int "ESW LAN2 Port ID (0..4)"
	depends on RAETH_ESW_CONTROL
	default 1

config  RAETH_ESW_PORT_LAN3
	int "ESW LAN3 Port ID (0..4)"
	depends on RAETH_ESW_CONTROL
	default 2

config  RAETH_ESW_PORT_LAN4
	int "ESW LAN4 Port ID (0..4)"
	depends on RAETH_ESW_CONTROL
	default 3

endif 	# RAETH
```
